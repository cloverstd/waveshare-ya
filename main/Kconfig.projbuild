## main/Kconfig.projbuild
```kconfig
menu "YA development diagnostics"
config YA_OTA_TEST_FAILURE
    int "OTA pending-boot fault injection (0=off, 1=abort, 2=watchdog)"
    range 0 2
    default 0
    help
        Development builds only. Never enable in distributed firmware.
config YA_TEST_HTTPS_CA
    bool "Trust local HTTPS test fixture CA"
    default n
    help
        Embeds private/test-ca.crt into test firmware only. Release builds must disable.
endmenu
```

## sdkconfig.defaults
```kconfig
CONFIG_IDF_TARGET="esp32s3"
CONFIG_ESPTOOLPY_FLASHMODE_QIO=y
CONFIG_ESPTOOLPY_FLASHSIZE_16MB=y
CONFIG_PARTITION_TABLE_CUSTOM=y
CONFIG_PARTITION_TABLE_CUSTOM_FILENAME="partitions.csv"
CONFIG_SPIRAM=y
CONFIG_SPIRAM_MODE_OCT=y
CONFIG_SPIRAM_SPEED_80M=y
CONFIG_SPIRAM_FETCH_INSTRUCTIONS=y
CONFIG_SPIRAM_RODATA=y
CONFIG_ESP_DEFAULT_CPU_FREQ_MHZ_240=y
CONFIG_ESP_CONSOLE_USB_SERIAL_JTAG=y
CONFIG_FREERTOS_HZ=1000
CONFIG_ESP_MAIN_TASK_STACK_SIZE=8192
CONFIG_COMPILER_OPTIMIZATION_SIZE=y
CONFIG_BOOTLOADER_APP_ROLLBACK_ENABLE=y
CONFIG_SECURE_SIGNED_APPS_NO_SECURE_BOOT=y
CONFIG_SECURE_SIGNED_APPS_RSA_SCHEME=y
CONFIG_SECURE_BOOT_BUILD_SIGNED_BINARIES=y
CONFIG_SECURE_BOOT_SIGNING_KEY="private/keys/ota-signing.pem"
CONFIG_ESP_TASK_WDT_EN=y
CONFIG_ESP_TASK_WDT_INIT=y
CONFIG_ESP_TASK_WDT_PANIC=y
CONFIG_ESP_TASK_WDT_TIMEOUT_S=15
CONFIG_ESP_COREDUMP_ENABLE_TO_FLASH=y
CONFIG_ESP_COREDUMP_DATA_FORMAT_ELF=y
CONFIG_MBEDTLS_CERTIFICATE_BUNDLE=y
CONFIG_MBEDTLS_CERTIFICATE_BUNDLE_DEFAULT_FULL=y
CONFIG_MBEDTLS_EXTERNAL_MEM_ALLOC=y
CONFIG_BT_ENABLED=y
CONFIG_BT_NIMBLE_ENABLED=y
CONFIG_BT_NIMBLE_MAX_CONNECTIONS=4
CONFIG_BT_NIMBLE_MAX_BONDS=6
CONFIG_BT_NIMBLE_NVS_PERSIST=y
CONFIG_BT_NIMBLE_ATT_PREFERRED_MTU=256
CONFIG_BT_NIMBLE_HOST_TASK_STACK_SIZE=8192
CONFIG_ESP_COEX_SW_COEXIST_ENABLE=y
CONFIG_FATFS_LFN_HEAP=y
CONFIG_FATFS_MAX_LFN=255
CONFIG_BSP_SD_FORMAT_ON_MOUNT_FAIL=n
CONFIG_SPIFFS_USE_MAGIC=y
CONFIG_SPIFFS_USE_MAGIC_LENGTH=y
CONFIG_BSP_ERROR_CHECK=n
CONFIG_LV_USE_CLIB_MALLOC=y
CONFIG_LV_USE_CLIB_STRING=y
CONFIG_LV_USE_CLIB_SPRINTF=y
CONFIG_LV_OS_FREERTOS=y
CONFIG_LV_DEF_REFR_PERIOD=33
CONFIG_LV_FONT_MONTSERRAT_20=y
CONFIG_LV_FONT_MONTSERRAT_28=y
CONFIG_LV_FONT_MONTSERRAT_40=y
CONFIG_LV_USE_FLEX=y
CONFIG_LV_USE_GRID=y
CONFIG_LV_USE_KEYBOARD=y
CONFIG_LV_USE_TEXTAREA=y
CONFIG_LV_USE_DROPDOWN=y
CONFIG_LV_USE_SWITCH=y
CONFIG_LV_USE_SLIDER=y
CONFIG_LV_USE_CANVAS=y
CONFIG_LV_USE_QRCODE=y
CONFIG_LV_USE_LABEL=y

CONFIG_LV_USE_SNAPSHOT=y

CONFIG_ESP_SYSTEM_EVENT_TASK_STACK_SIZE=8192

CONFIG_SPIRAM_MALLOC_ALWAYSINTERNAL=1024

CONFIG_SPIRAM_MALLOC_RESERVE_INTERNAL=32768

CONFIG_BT_NIMBLE_MEM_ALLOC_MODE_EXTERNAL=y

CONFIG_ESP_LVGL_ADAPTER_ENABLE_FPS_STATS=y

CONFIG_LV_OBJ_STYLE_CACHE=y

CONFIG_PM_ENABLE=y
CONFIG_FREERTOS_USE_TICKLESS_IDLE=y
CONFIG_BT_CTRL_MODEM_SLEEP=y
CONFIG_BT_CTRL_MODEM_SLEEP_MODE_1=y
CONFIG_BT_CTRL_LPCLK_SEL_MAIN_XTAL=y
CONFIG_BT_CTRL_MAIN_XTAL_PU_DURING_LIGHT_SLEEP=y
CONFIG_ESP_PHY_MAC_BB_PD=y

# CONFIG_ESP_WIFI_IRAM_OPT is not set

# CONFIG_ESP_WIFI_RX_IRAM_OPT is not set

CONFIG_ESP_WIFI_11KV_SUPPORT=y
CONFIG_ESP_WIFI_RRM_SUPPORT=y
CONFIG_ESP_WIFI_WNM_SUPPORT=y
CONFIG_ESP_WIFI_11R_SUPPORT=y
# CONFIG_ESP_WIFI_ENABLE_ROAMING_APP is not set

# Runtime log app: Warning by default, all levels available for diagnostics.
CONFIG_LOG_VERSION_1=y
CONFIG_LOG_DEFAULT_LEVEL_WARN=y
CONFIG_LOG_MAXIMUM_LEVEL_VERBOSE=y
CONFIG_LOG_DYNAMIC_LEVEL_CONTROL=y
```
